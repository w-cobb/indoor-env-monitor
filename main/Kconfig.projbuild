## main/Kconfig.projbuild
```kconfig
menu "Indoor Environment Monitor"

    orsource "$IDF_PATH/examples/common_components/env_caps/$IDF_TARGET/Kconfig.env_caps"

    config I2C_MASTER_SCL
        int "SCL GPIO Num"
        range ENV_GPIO_RANGE_MIN ENV_GPIO_OUT_RANGE_MAX
        default 22
        help
            GPIO number for I2C Master clock line.

    config I2C_MASTER_SDA
        int "SDA GPIO Num"
        range ENV_GPIO_RANGE_MIN ENV_GPIO_OUT_RANGE_MAX
        default 21
        help
            GPIO number for I2C Master data line.

    config I2C_MASTER_FREQUENCY
        int "Master Frequency"
        default 400000
        help
            I2C speed of master device.

    config UART_PORT
        int "UART Port Number"
        default 1
        help
            UART port number.
    
    config UART_BAUD_RATE
        int "Baud Rate"
        default 9600
        help
            Baud Rate for UART.
    
    config UART_RX_BUFFER_SIZE
        int "RX Buffer Size"
        default 1024
        help
            Size in bytes of receive buffer.

    config UART_TX_BUFFER_SIZE
        int "TX Buffer Size"
        default 1024
        help 
            Size in bytes of transmit buffer.
    
    config UART_EVENT_QUEUE_SIZE
        int "Event Queue Size"
        default 10
        help 
            Size of the UART event queue.
    
    config UART_RX_PIN
        int "UART Receive Pin"
        range ENV_GPIO_RANGE_MIN ENV_GPIO_OUT_RANGE_MAX
        default 9
        help
            Pin that UART RX is connected to.

    config UART_TX_PIN
        int "UART Transmit Pin"
        range ENV_GPIO_RANGE_MIN ENV_GPIO_OUT_RANGE_MAX
        default 10
        help
            Pin that UART TX is connected to.

endmenu
```
